#define FASTLED_ALLOW_INTERRUPTS 0
#include <FastLED.h>

#include <Streaming.h>

#include "time.h"
#include <ESP8266WiFi.h>
//#include <WiFi.h>

const char* ssid     = "Alex V30";                    // your network SSID (name)
const char* password = "snoopdoge";                    // your network password


const char* ntpServer = "pool.ntp.org";
const long  gmtOffset_sec = 0;
const int   daylightOffset_sec = 3600;


#define DATA 2  // D4
#define WIDTH (32*2)
#define HEIGHT 8
#define NUM_LEDS (WIDTH*HEIGHT)

int getIndex(int, int);

CRGB leds[NUM_LEDS];


byte font[128][8] = {
    { 0x00, 0x00, 0x00, 0x00, 0x00, 0x00, 0x00, 0x00},   // U+0000 (nul)
    { 0x00, 0x00, 0x00, 0x00, 0x00, 0x00, 0x00, 0x00},   // U+0001
    { 0x00, 0x00, 0x00, 0x00, 0x00, 0x00, 0x00, 0x00},   // U+0002
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    { 0x00, 0x00, 0x00, 0x00, 0x00, 0x00, 0x00, 0x00}    // U+007F
};

int i = 0;
const byte NUM_THREADS = 6;

byte hues[NUM_THREADS];
byte phases[NUM_THREADS];
byte frequencies[NUM_THREADS];

byte is[NUM_THREADS];
byte speeds[NUM_THREADS];

byte pxs[NUM_THREADS];
byte pys[NUM_THREADS];

int px, py, hue;


/*
  %a Abbreviated weekday name
  %A Full weekday name
  %b Abbreviated month name
  %B Full month name
  %c Date and time representation for your locale
  %d Day of month as a decimal number (01-31)
  %H Hour in 24-hour format (00-23)
  %I Hour in 12-hour format (01-12)
  %j Day of year as decimal number (001-366)
  %m Month as decimal number (01-12)
  %M Minute as decimal number (00-59)
  %p Current locale's A.M./P.M. indicator for 12-hour clock
  %S Second as decimal number (00-59)
  %U Week of year as decimal number,  Sunday as first day of week (00-51)
  %w Weekday as decimal number (0-6; Sunday is 0)
  %W Week of year as decimal number, Monday as first day of week (00-51)
  %x Date representation for current locale
  %X Time representation for current locale
  %y Year without century, as decimal number (00-99)
  %Y Year with century, as decimal number
  %z %Z Time-zone name or abbreviation, (no characters if time zone is unknown)
  %% Percent sign
  You can include text literals (such as spaces and colons) to make a neater display or for padding between adjoining columns.
  You can suppress the display of leading zeroes  by using the "#" character  (%#d, %#H, %#I, %#j, %#m, %#M, %#S, %#U, %#w, %#W, %#y, %#Y)
*/
char myBuffer[80];

void printLocalTime() {
  time_t rawtime;
  struct tm * timeinfo;

  time (&rawtime);
  timeinfo = localtime (&rawtime);

//  strftime (myBuffer,80," %d %B %Y %H:%M:%S ",timeinfo);
  strftime (myBuffer,80," %H:%M:%S ",timeinfo);
  //struct tm timeinfo;
  //time_t now = time(nullptr);
  Serial.println(myBuffer);
  //Serial.print(ctime(&now));
  //Serial.print(&timeinfo, " %d %B %Y %H:%M:%S ");
}

void setup()
{
  Serial.begin(115200);
  delay(10);


  FastLED.addLeds<WS2812B, DATA, GRB>(leds, 0, NUM_LEDS);
  FastLED.setMaxPowerInVoltsAndMilliamps(5, 500);
  FastLED.setCorrection( TypicalLEDStrip );
  FastLED.setBrightness(64);
  FastLED.clear();
  FastLED.show();
  for(int i = 0; i < NUM_THREADS; i++) {
    frequencies[i] = random(1, 6);
    phases[i] = random(0, 255);
    is[i] = phases[i];
    speeds[i] = random(1, 3);
    hues[i] = random(0, 256); //max 256
  }

  // We start by connecting to a WiFi network
  Serial.print("\n\nConnecting to ");
  Serial.println(ssid);
 
  /* Explicitly set the ESP8266 to be a WiFi-client, otherwise, it by default,
    would try to act as both a client and an access-point and could cause
  network-issues with your other WiFi-devices on your WiFi-network. */
  WiFi.mode(WIFI_STA);
  WiFi.begin(ssid, password);
 
  while (WiFi.status() != WL_CONNECTED)
  {
    delay(500);
    Serial.print(".");
  }
 
  Serial.println();
  Serial.println("WiFi connected");
  Serial.print("IP address: ");
  Serial.println(WiFi.localIP());
 
  configTime(gmtOffset_sec, daylightOffset_sec, ntpServer);
 
  Serial.println("\nWaiting for time");
  unsigned timeout = 5000;
  unsigned start = millis();
  while (!time(nullptr))
  {
    Serial.print(".");
    delay(1000);
  }
  delay(1000);
 
  Serial.println("Time...");
}

void loop()
{
  printLocalTime();


  delay(1000);



  byte numColors = 255;
  hue = ((int)(millis()/100) % numColors)*255/numColors;

  // TEXT
  FastLED.clear();
  int scroll = 0;//millis()*8/1000;
//  int scroll = 0;
//  String message = "alphabet";/
//  String message = String((int)(millis()/1000));
//  String message = String((int)(millis()/100)/10.0f);
  String message = String(myBuffer);
  message.trim();
  for(int cIndex = 0; cIndex < message.length()-1; cIndex++) {
    char c = message.charAt(cIndex);
    for (int x = 0; x < 8; x++) {
      byte bitMask = 0x01;
      byte f = font[c][x];
      for (int y = 0; y < 8; y++) {
        if (f & bitMask){
//          leds[ getIndex(y+cIndex*8, 7-x) ] = CRGB(255, 0, 0);
          leds[ getIndex((scroll+y+cIndex*8) % WIDTH, 7-x) ] = CHSV(hue, 255, 255);
        }else{
//          leds[ getIndex(y+cIndex*8, 7-x) ] = CRGB(0, 0, 0);
          leds[ getIndex((scroll+y+cIndex*8) % WIDTH, 7-x) ] = CRGB(0, 0, 0);
        }
        bitMask = bitMask << 1;
      }
    }
  }

//  //RAINBOW
//  delay(10);
//  fill_solid( leds, NUM_LEDS, CHSV(hue, 255, 255) );
//  fill_rainbow( leds, NUM_LEDS, hue, 1 );
//  hue++;
  FastLED.show();
}

int getIndex(int x, int y) {
  int index = (WIDTH-1-x)*8;
  if(x % 2 == 0) {
    index += 7-y;
  }
  else {
    index += y;
  }

  if(index < 0 || index > NUM_LEDS-1) {
    index = 1; //for debugging
  }

  return index;
}
