#define FASTLED_ALLOW_INTERRUPTS 0
#include <FastLED.h>
#include <Streaming.h>

// pins for wemos d1 mini
#define DATA 2  // D4

#define WIDTH (32*2)
#define HEIGHT 8
#define NUM_LEDS (WIDTH*HEIGHT)

int getIndex(int, int);

CRGB leds[NUM_LEDS];


/*
    The 8x8 font is ported from
    https://github.com/dhepper/font8x8/blob/master/font8x8_basic.h
*/
byte font[128][8] = {
  { 0x00, 0x00, 0x00, 0x00, 0x00, 0x00, 0x00, 0x00},   // U+0000 (nul)
  { 0x00, 0x00, 0x00, 0x00, 0x00, 0x00, 0x00, 0x00},   // U+0001
  { 0x00, 0x00, 0x00, 0x00, 0x00, 0x00, 0x00, 0x00},   // U+0002
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  { 0x00, 0x00, 0x00, 0x00, 0x00, 0x00, 0x00, 0x00}    // U+007F
};

// ===========================

int i = 0;
const byte NUM_THREADS = 6;

byte hues[NUM_THREADS];
byte phases[NUM_THREADS];
byte frequencies[NUM_THREADS];

byte is[NUM_THREADS];
byte speeds[NUM_THREADS];

byte pxs[NUM_THREADS];
byte pys[NUM_THREADS];

int scroll = 0;
int messageLength = 0;
int px, py, hue;

void setup() {
  FastLED.addLeds<WS2812B, DATA, GRB>(leds, 0, NUM_LEDS);
  FastLED.setMaxPowerInVoltsAndMilliamps(5, 500);
  FastLED.setCorrection( TypicalLEDStrip );
  FastLED.setBrightness(64);
  FastLED.clear();
  FastLED.show();

  Serial.begin(115200);

  for (int i = 0; i < NUM_THREADS; i++) {
    frequencies[i] = random(1, 6);
    phases[i] = random(0, 255);
    is[i] = phases[i];
    speeds[i] = random(1, 3);
    hues[i] = random(0, 256); //max 256
  }
}

void loop() {


  //  byte numColors = 255;

  //  byte numColors = 32;
  //  hue = ((int)(millis()/100) % numColors)*255/numColors;
  // hue = 0;

  //  // TEXT
  //  FastLED.clear();
  //  int scroll = (millis()*6/1000) % WIDTH;
  ////  int scroll = 0;
  ////  String message = "/|\\-/|\\-";
  ////  String message = "this is a really long string";
  //  // String message = "RAINBOW";
  // String message = "ALPHABET";
  ////  String message = String((int)(millis()/1000));
  ////  String message = String((int)(millis()/100)/10.0f);
  //  for(int cIndex = 0; cIndex < message.length(); cIndex++) {
  //    char c = message.charAt(cIndex);
  //    for (int x = 0; x < 8; x++) {
  //      byte bitMask = 0x01;
  //      byte f = font[c][x];
  //      for (int y = 0; y < 8; y++) {
  //        if (f & bitMask){
  ////          leds[ getIndex(y+cIndex*8, 7-x) ] = CRGB(255, 0, 0);
  //          leds[ getIndex((WIDTH-scroll+y+cIndex*8) % WIDTH, 7-x) ] = CHSV(hue, 255, 255);
  //        }else{
  ////          leds[ getIndex(y+cIndex*8, 7-x) ] = CRGB(0, 0, 0);
  //          leds[ getIndex((WIDTH-scroll+y+cIndex*8) % WIDTH, 7-x) ] = CRGB(0, 0, 0);
  //        }
  //        bitMask = bitMask << 1;
  //      }
  //    }
  //  }


  // TEXT 2
  FastLED.clear();
  int scroll = WIDTH;
  if (messageLength > 0) {
    scroll = WIDTH - ((millis() * 10 / 1000) % (messageLength + WIDTH)); //number between 0 and -WIDTH
  }

  //  String message = "love and kindness";
  //  String message = "try to think of something cool to write here";
  //  String message = "this is my test string";
  //  String message = "a quick brown fox jumps over the lazy dog";
  String message = "8x8x8 LED CUBE";
  //  String message = "!\"#$%&'()*+,-./0123456789:/<=>?@ABCDEFGHIJKLMNOPQRSTUVWXYZ[\\]^_`abcdefghijklmnopqrstuvwxyz{|}~";

  int x = scroll;
  unsigned int charIndex = 0;
  byte bitMask = 0x01;

  //  while(x < WIDTH) {
  while ( !(charIndex == message.length() && bitMask == (1 << 7)) ) {
    char c = message.charAt(charIndex);
    boolean emptyColumn = true;
    for (int y = 7; y >= 0; y--) {
      byte f = font[c][7 - y];
      if (f & bitMask) {
        if (x >= 0 && x < WIDTH) {
          //          leds[ getIndex(x, y) ] = CRGB(255, 0, 0);


          //          byte minimum = 0x20; // start of readable characters
//          byte minimum = 0x38; //8
//          byte minimum = 0x61; //a
//          byte maximum = 0x7A; //z
//          byte maximum = 0x78; //something...
          //          byte maximum = 0x7F; // end of all readable characters

//          byte hue = 255 * (c - minimum) / (maximum - minimum);
//          leds[ getIndex(x, y) ] = CHSV(hue, 255, 255);
          byte hue = 255 * charIndex/message.length();
          leds[ getIndex(x, y) ] = CHSV(hue, 255, 255);
        }
        emptyColumn = false;
      }
    }
    if (bitMask == (1 << 7)) {
      if (c == ' ') {
        x += 3;
      }
      bitMask = 0x01;
      charIndex++;
      x++;
      if (charIndex == message.length()) {
        break;
      }
    }
    else {
      bitMask = bitMask << 1;
      if (!emptyColumn) {
        x++;
      }
    }

    if (x == WIDTH && messageLength > 0) {
      break;
    }
  }

  if (messageLength == 0) {
    messageLength = x - scroll;
  }

  // if we've drawn the ending of the string, start drawing the beginning too
  //  if(x <= 0) {
  //    //TODO
  //    scroll = WIDTH;
  //  }
  //  if(x < WIDTH-1) {
  //    //TODO
  //  }

  FastLED.show();
  delay(100);
  scroll--;




  //  //BOUNCING BALLS
  //  //fade the leds
  //  fadeToBlackBy( leds, NUM_LEDS, 32);
  //
  //  for(int t = 0; t < NUM_THREADS; t++) {
  //    //erase the old dot
  //    byte px = pxs[t];
  //    byte py = pys[t];
  ////    leds[ getIndex(px, py) ] = CRGB(0, 0, 0)/;
  //
  //    byte y = sin8( frequencies[t]*(is[t]) )/32;
  ////    byte y = sin8( frequencies[t]*(is[t] + phases[t]) )/32;
  //    byte x = int(is[t])*WIDTH/255;
  //    leds[ getIndex(x, y) ] = CHSV(hues[t], 255-32, 255);
  //
  //    pxs[t] = x;
  //    pys[t] = y;
  //
  //    is[t] += speeds[t];
  //  }
  //  delay(10);



  //  // SCROLLING RED DOT
  //  for(int y = 0; y < HEIGHT; y++) {
  //    for(int x = 0; x < WIDTH; x++) {
  //      leds[ getIndex(px, py) ] = CRGB(0, 0, 0);
  //      leds[ getIndex(x, y) ] = CRGB(255, 0, 0);
  //      FastLED.show();
  //      px = x;
  //      py = y;
  //      delay(100);
  //    }
  //  }



  //  //RAINBOW
  //  delay(10);
  //  fill_solid( leds, NUM_LEDS, CHSV(hue, 255, 255) );
  //  fill_rainbow( leds, NUM_LEDS, hue, 1 );
  //  hue++;


  FastLED.show();
}

// ----------------------------

int getIndex(int x, int y) {
  int index = (WIDTH - 1 - x) * 8;
  if (x % 2 == 0) {
    index += 7 - y;
  }
  else {
    index += y;
  }

  if (index < 0 || index > NUM_LEDS - 1) {
    index = 1; //for debugging
  }

  return index;
}
